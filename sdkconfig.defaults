## sdkconfig.defaults
```kconfig
# WiFi
CONFIG_ESP_WIFI_SOFTAP_SUPPORT=y

# HTTP Server with WebSocket support
CONFIG_HTTPD_WS_SUPPORT=y
CONFIG_HTTPD_MAX_REQ_HDR_LEN=1024
CONFIG_HTTPD_MAX_URI_LEN=512

# Increase socket count for WebSocket clients
CONFIG_LWIP_MAX_SOCKETS=16

# Task watchdog
CONFIG_ESP_TASK_WDT_TIMEOUT_S=10

# Log level
CONFIG_LOG_DEFAULT_LEVEL_INFO=y

# FreeRTOS tick rate
CONFIG_FREERTOS_HZ=1000
```
